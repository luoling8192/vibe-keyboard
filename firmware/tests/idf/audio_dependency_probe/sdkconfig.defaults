## firmware/tests/idf/audio_dependency_probe/sdkconfig.defaults
```kconfig
CONFIG_IDF_TARGET="esp32s3"
CONFIG_SPIRAM=y
CONFIG_SPIRAM_MODE_OCT=y
CONFIG_SPIRAM_SPEED_80M=y
CONFIG_SPIRAM_BOOT_INIT=y
CONFIG_SPIRAM_USE_CAPS_ALLOC=y
CONFIG_OPUS_THREADSAFE_PSEUDOSTACK=y
CONFIG_OPUS_PSEUDOSTACK_SIZE=120000
CONFIG_OPUS_STATE_PREFER_PSRAM=y
CONFIG_OPUS_PSEUDOSTACK_PREFER_PSRAM=y
# CONFIG_OPUS_FLOATING_POINT is not set
CONFIG_OPUS_ENABLE_XTENSA_OPTIMIZATIONS=y
CONFIG_BT_ENABLED=n
CONFIG_ESP_CONSOLE_NONE=y
CONFIG_ESP_CONSOLE_SECONDARY_NONE=y
CONFIG_LOG_DEFAULT_LEVEL_NONE=y
```
